## configs/qcm6490_cdba_defconfig
```kconfig
# Configuration for building U-Boot to be flashed
# to the uefi partition of QCM6490 dev boards with
# the "Linux Embedded" partition layout (which have
# a dedicated "uefi" partition for edk2/U-Boot)

#include "qcm6490_defconfig"

# Otherwise buildman thinks this isn't an ARM platform
CONFIG_ARM=y

CONFIG_DEFAULT_ENV_FILE="board/qualcomm/cdba.env"

# Avoid conflicting with chainloaded U-Boot EFI config
# on ESP
CONFIG_EFI_VARIABLE_NO_STORE=y
```

## configs/qcom_defconfig
```kconfig
CONFIG_ARM=y
CONFIG_SKIP_LOWLEVEL_INIT=y
CONFIG_POSITION_INDEPENDENT=y
CONFIG_ARCH_SNAPDRAGON=y
CONFIG_DEFAULT_DEVICE_TREE="dragonboard845c"
CONFIG_SYS_LOAD_ADDR=0x0
CONFIG_ANDROID_BOOT_IMAGE=y
CONFIG_FIT=y
CONFIG_FIT_VERBOSE=y
CONFIG_BOOTSTD_FULL=y
CONFIG_BOOTSTD_IGNORE_BOOTABLE=y
# CONFIG_BOOTMETH_EXTLINUX is not set
# CONFIG_BOOTMETH_VBE is not set
# CONFIG_BOOTMETH_SCRIPT is not set
# CONFIG_CMD_BOOTEFI_BOOTMGR is not set
CONFIG_USE_PREBOOT=y
CONFIG_LOG_MAX_LEVEL=9
CONFIG_LOG_DEFAULT_LEVEL=4
# CONFIG_DISPLAY_CPUINFO is not set
CONFIG_DISPLAY_BOARDINFO_LATE=y
CONFIG_HUSH_PARSER=y
CONFIG_SYS_MAXARGS=64
CONFIG_SYS_CBSIZE=512
CONFIG_CMD_BOOTEFI_SELFTEST=y
CONFIG_CMD_BOOTMENU=y
CONFIG_CMD_NVEDIT_EFI=y
CONFIG_CMD_CLK=y
CONFIG_CMD_GPIO=y
CONFIG_CMD_GPT=y
CONFIG_CMD_MMC=y
CONFIG_CMD_PART=y
CONFIG_CMD_UFS=y
CONFIG_CMD_USB=y
CONFIG_CMD_USB_MASS_STORAGE=y
CONFIG_CMD_CAT=y
CONFIG_CMD_BMP=y
CONFIG_CMD_EFIDEBUG=y
CONFIG_CMD_FAT=y
CONFIG_CMD_FS_GENERIC=y
CONFIG_CMD_LOG=y
CONFIG_ISO_PARTITION=y
# CONFIG_NET is not set
CONFIG_CLK=y
CONFIG_CLK_QCOM_QCM2290=y
CONFIG_CLK_QCOM_QCS404=y
CONFIG_CLK_QCOM_SDM845=y
CONFIG_CLK_QCOM_SM6115=y
CONFIG_CLK_QCOM_SM7150=y
CONFIG_CLK_QCOM_SM8250=y
CONFIG_CLK_QCOM_SC7280=y
CONFIG_USB_FUNCTION_FASTBOOT=y
CONFIG_FASTBOOT_BUF_ADDR=0x1
CONFIG_FASTBOOT_FLASH=y
CONFIG_FASTBOOT_FLASH_MMC_DEV=0
CONFIG_MSM_GPIO=y
CONFIG_QCOM_PMIC_GPIO=y
CONFIG_DM_KEYBOARD=y
CONFIG_BUTTON_KEYBOARD=y
CONFIG_BUTTON_QCOM_PMIC=y
CONFIG_IOMMU=y
CONFIG_ARM_SMMU=y
CONFIG_MISC=y
CONFIG_MMC_SDHCI=y
CONFIG_MMC_SDHCI_MSM=y
CONFIG_PHY=y
CONFIG_PHY_QCOM_QMP_UFS=y
CONFIG_PHY_QCOM_QUSB2=y
CONFIG_PHY_QCOM_USB_HS_7NM=y
CONFIG_PINCTRL=y
CONFIG_PINCTRL_QCOM_QCM2290=y
CONFIG_PINCTRL_QCOM_QCS404=y
CONFIG_PINCTRL_QCOM_SDM845=y
CONFIG_PINCTRL_QCOM_SM6115=y
CONFIG_PINCTRL_QCOM_SM7150=y
CONFIG_PINCTRL_QCOM_SM8250=y
CONFIG_DM_PMIC=y
CONFIG_PMIC_QCOM=y
CONFIG_DM_REGULATOR=y
CONFIG_DM_REGULATOR_GPIO=y
CONFIG_DM_RTC=y
CONFIG_RTC_EMULATION=y
CONFIG_SCSI=y
CONFIG_DM_SCSI=y
CONFIG_MSM_GENI_SERIAL=y
CONFIG_SPMI_MSM=y
CONFIG_SYSINFO=y
CONFIG_SYSINFO_SMBIOS=y
CONFIG_USB=y
CONFIG_DM_USB_GADGET=y
CONFIG_USB_XHCI_HCD=y
CONFIG_USB_XHCI_DWC3=y
CONFIG_USB_DWC3=y
CONFIG_USB_DWC3_GENERIC=y
CONFIG_USB_STORAGE=y
CONFIG_USB_GADGET=y
CONFIG_USB_GADGET_VENDOR_NUM=0x18d1
CONFIG_USB_GADGET_PRODUCT_NUM=0xd00d
CONFIG_UFS=y
CONFIG_QCOM_UFS=y
CONFIG_VIDEO=y
# CONFIG_VIDEO_FONT_8X16 is not set
CONFIG_VIDEO_FONT_16X32=y
CONFIG_SYS_WHITE_ON_BLACK=y
CONFIG_NO_FB_CLEAR=y
CONFIG_VIDEO_SIMPLE=y
CONFIG_SMBIOS=y
CONFIG_EFI_SET_TIME=y
CONFIG_LMB_MAX_REGIONS=64
#CONFIG_AUTOBOOT_MENU_SHOW=y
CONFIG_AUTOBOOT_KEYED=y
CONFIG_AUTOBOOT_FLUSH_STDIN=y
CONFIG_AUTOBOOT_PROMPT="Press power button to stop autoboot %d\n"
CONFIG_AUTOBOOT_STOP_STR="\r"
CONFIG_SYS_CONSOLE_INFO_QUIET=y
CONFIG_BOOT_RETRY=y
CONFIG_BOOT_RETRY_TIME=2
CONFIG_USB_FUNCTION_ACM=y
CONFIG_EFI_RUNTIME_UPDATE_CAPSULE=y
CONFIG_EFI_CAPSULE_ON_DISK=y
CONFIG_EFI_IGNORE_OSINDICATIONS=y
CONFIG_CMD_DFU=y
CONFIG_EFI_CAPSULE_FIRMWARE_RAW=y
CONFIG_DFU_SCSI=y
CONFIG_SYS_DFU_MAX_FILE_SIZE=0x200000
CONFIG_SYS_DFU_DATA_BUF_SIZE=0x200000
CONFIG_SYS_MALLOC_LEN=0x1000000
CONFIG_TOOLS_MKEFICAPSULE=y
CONFIG_EFI_CAPSULE_ON_DISK_EARLY=y
CONFIG_WDT=y
CONFIG_WDT_QCOM=y
```

## drivers/firmware/qcom/Kconfig
```kconfig
config QCOM_SCM
	bool "Qualcomm Secure Channel Manager (SCM) driver"
	select FIRMWARE
	help
	  The Qualcomm Secure Channel Manager (SCM) driver is used to communicate
	  with the secure firmware running on Qualcomm SoCs to perform various
	  platform management services.
```

## drivers/input/touchscreen/Kconfig
```kconfig
menuconfig TOUCHSCREEN
	bool "Touchscreen support"
	default n
	depends on INPUT
	help
	  Enable support for touchscreens.

if TOUCHSCREEN

config TOUCHSCREEN_SYNAPTICS_S3908
	bool "Synaptics S3908 touchscreen"
	depends on TOUCHSCREEN && I2C
	help
	  Say Y here if you have a Synaptics S3908 touchscreen.

endif
```
