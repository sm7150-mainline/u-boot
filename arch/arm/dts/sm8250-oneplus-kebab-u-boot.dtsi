
/ {
	chosen {
		#address-cells = <2>;
		#size-cells = <2>;
		ranges;

		stdout-path = "serial0:115200n8";

		framebuffer: framebuffer@9c000000 {
			compatible = "simple-framebuffer";
			reg = <0 0x9c000000 0 0x2300000>;
			width = <1080>;
			height = <2400>;
			stride = <(1080 * 4)>;
			format = "a8r8g8b8";
		};
	};

	/* When running as the primary bootloader or with DT embedded into U-Boot
	 * ABL won't populate this for us.
	 */
	memory@80000000 {
		device_type = "memory";
		reg = <0 0x80000000 0 0x3B800000>,
		      <0 0xC0000000 0 0xC0000000>,
		      <1 0x80000000 1 0x00000000>;
	};
};
