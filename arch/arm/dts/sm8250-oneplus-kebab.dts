// SPDX-License-Identifier: GPL-2.0 OR BSD-3-Clause
/*
 * Copyright (c) 2024, Caleb Connolly <caleb.connolly@linaro.org>
 */

#include "sm8250-oneplus.dtsi"

/ {
	model = "OnePlus 8T";
	compatible = "oneplus,kebab", "qcom,sm8250";
};

&display_panel {
	compatible = "samsung,amb655x";
	//status = "okay";
};

&mdss {
	status = "disabled";
};

&mdss_dsi0 {
	status = "disabled";
};
